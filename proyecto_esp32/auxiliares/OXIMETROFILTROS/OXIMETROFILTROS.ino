float resultadoPasaBajos[500];
float resultadoPasaAltos[500];
float resultadoPasaAltos2[500];
float resultadoPasaBajos2[500];
float imprimirPasaBajos[500];
float imprimirPasaAltos[500];
float senal[500]={122741, 122762, 122778, 122776, 122790, 122810, 122796, 122807, 122860, 122886, 122856, 122747, 122673,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 122985, 122919};
float hamming[500]={0.08, 0.08003647, 0.08014586, 0.08032815, 0.08058333, 0.08091135, 0.08131215, 0.08178567, 0.08233184, 0.08295058, 0.08364177, 0.08440532, 0.0852411 ,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 0.08003647, 0.08};
     
float calculoFrecuenciaCardiaca(float entrada[500]);

void setup() {
  Serial.begin(115200);
}

void loop() {
  // put your main code here, to run repeatedly:

    Serial.print("ANALIZANDO señal \n");
    
    float valorDC;
    int i;
    ///---------------CALCULAR Y ELIMINAR EL VALOR DC---------------
    
    // Filtro pasa bajos a 1 Hz
    float b[4]= {2.91464945e-05, 8.74394834e-05, 8.74394834e-05, 2.91464945e-05};
    float a[4]= {1, -2.87435689,  2.7564832, -0.88189313};
    resultadoPasaBajos[0]=senal[0];
    resultadoPasaBajos[1]=senal[0];
    resultadoPasaBajos[2]=senal[0];
    senal[1]=senal[0];
    senal[2]=senal[0];
    senal[3]=senal[0];
    for ( i = 3; i < 499; i++ ) {
        resultadoPasaBajos[i] =senal[i]*b[0]+senal[i-1]*b[1]+senal[i-2]*b[2]+senal[i-3]*b[3]-(resultadoPasaBajos[i-1]*a[1]+resultadoPasaBajos[i-2]*a[2]+resultadoPasaBajos[i-3]*a[3]);
        //Serial.print( "%f\n", resultadoPasaBajos[i]);
    }

    valorDC=0;
    for ( i = 200; i < 499; i++ ) {
        valorDC=valorDC+resultadoPasaBajos[i];
    }
    valorDC=valorDC/300;

    for ( i = 0; i < 499; i++ ) {
        senal[i]=senal[i]-valorDC;
        //Serial.print( "%f\n", senal[i]);
    }
    Serial.print("el valor DC es");
    Serial.print(valorDC);
    ///-------------------------------------------------------------



    ///---------------CALCULAR EL VALOR AC--------------------------    
    
    // Filtro pasa altos a 0.5 Hz
    b[0]=0.96907117; b[1]=-2.90721352;  b[2]=2.90721352; b[3]=-0.96907117;
    a[0]=1; a[1]=-2.93717073; a[2]=2.87629972; a[3]=-0.93909894;
    senal[0]=senal[0]/2;
    resultadoPasaAltos[0]=senal[0];
    resultadoPasaAltos[1]=senal[0];
    resultadoPasaAltos[2]=senal[0];
    senal[1]=senal[0];
    senal[2]=senal[0];
    senal[3]=senal[0];
    for ( i = 3; i < 499; i++ ) {
        resultadoPasaAltos[i] =senal[i]*b[0]+senal[i-1]*b[1]+senal[i-2]*b[2]+senal[i-3]*b[3]-(resultadoPasaAltos[i-1]*a[1]+resultadoPasaAltos[i-2]*a[2]+resultadoPasaAltos[i-3]*a[3]);
        //Serial.print( "%f\n", resultadoPasaAltos[i]);
    }

    // INICIO IMPRIMIR
    // Filtro pasa altos a 0.5 Hz
    b[0]=0.96907117; b[1]=-2.90721352;  b[2]=2.90721352; b[3]=-0.96907117;
    a[0]=1; a[1]=-2.93717073; a[2]=2.87629972; a[3]=-0.93909894;
    resultadoPasaAltos[0]=resultadoPasaAltos[0]/2;
    imprimirPasaAltos[0]=resultadoPasaAltos[0];
    imprimirPasaAltos[1]=resultadoPasaAltos[0];
    imprimirPasaAltos[2]=resultadoPasaAltos[0];
    resultadoPasaAltos[1]=resultadoPasaAltos[0];
    resultadoPasaAltos[2]=resultadoPasaAltos[0];
    resultadoPasaAltos[3]=resultadoPasaAltos[0];
    for ( i = 3; i < 499; i++ ) {
        imprimirPasaAltos[i] =resultadoPasaAltos[i]*b[0]+resultadoPasaAltos[i-1]*b[1]+resultadoPasaAltos[i-2]*b[2]+resultadoPasaAltos[i-3]*b[3]-(imprimirPasaAltos[i-1]*a[1]+imprimirPasaAltos[i-2]*a[2]+imprimirPasaAltos[i-3]*a[3]);
        //Serial.print( "%f\n", imprimirPasaAltos[i]);
    }
    // filtro pasa bajos a 5 Hz.
    b[0]=0.00289819; b[1]=0.00869458;  b[2]=0.00869458; b[3]=0.00289819;
    a[0]=1; a[1]=-2.37409474; a[2]=1.92935567; a[3]=-0.53207537;
    imprimirPasaAltos[0]=imprimirPasaAltos[0]/2;
    imprimirPasaBajos[0]=imprimirPasaAltos[0];
    imprimirPasaBajos[1]=imprimirPasaAltos[0];
    imprimirPasaBajos[2]=imprimirPasaAltos[0];
    imprimirPasaAltos[1]=imprimirPasaAltos[0];
    imprimirPasaAltos[2]=imprimirPasaAltos[0];
    imprimirPasaAltos[3]=imprimirPasaAltos[0];
    for ( i = 3; i < 499; i++ ) {
        imprimirPasaBajos[i] =imprimirPasaAltos[i]*b[0]+imprimirPasaAltos[i-1]*b[1]+imprimirPasaAltos[i-2]*b[2]+imprimirPasaAltos[i-3]*b[3]-(imprimirPasaBajos[i-1]*a[1]+imprimirPasaBajos[i-2]*a[2]+imprimirPasaBajos[i-3]*a[3]);
        //Serial.println(imprimirPasaBajos[i]);
    }
    // FIN IMPRIMIR
    
    // ventana hamming 
    for ( i = 0; i < 499; i++ ) {
        resultadoPasaAltos[i]=resultadoPasaAltos[i]*hamming[i];
        //Serial.println(resultadoPasaAltos[i]);
    }

    // Filtro pasa altos a 0.5 Hz
    b[0]=0.96907117; b[1]=-2.90721352;  b[2]=2.90721352; b[3]=-0.96907117;
    a[0]=1; a[1]=-2.93717073; a[2]=2.87629972; a[3]=-0.93909894;
    resultadoPasaAltos[0]=resultadoPasaAltos[0]/2;
    resultadoPasaAltos2[0]=resultadoPasaAltos[0];
    resultadoPasaAltos2[1]=resultadoPasaAltos[0];
    resultadoPasaAltos2[2]=resultadoPasaAltos[0];
    resultadoPasaAltos[1]=resultadoPasaAltos[0];
    resultadoPasaAltos[2]=resultadoPasaAltos[0];
    resultadoPasaAltos[3]=resultadoPasaAltos[0];
    for ( i = 3; i < 499; i++ ) {
        resultadoPasaAltos2[i] =resultadoPasaAltos[i]*b[0]+resultadoPasaAltos[i-1]*b[1]+resultadoPasaAltos[i-2]*b[2]+resultadoPasaAltos[i-3]*b[3]-(resultadoPasaAltos2[i-1]*a[1]+resultadoPasaAltos2[i-2]*a[2]+resultadoPasaAltos2[i-3]*a[3]);
        //Serial.print( "%f\n", resultadoPasaAltos2[i]);
    }

    // filtro pasa bajos a 5 Hz.
    b[0]=0.00289819; b[1]=0.00869458;  b[2]=0.00869458; b[3]=0.00289819;
    a[0]=1; a[1]=-2.37409474; a[2]=1.92935567; a[3]=-0.53207537;
    resultadoPasaAltos2[0]=resultadoPasaAltos2[0]/2;
    resultadoPasaBajos2[0]=resultadoPasaAltos2[0];
    resultadoPasaBajos2[1]=resultadoPasaAltos2[0];
    resultadoPasaBajos2[2]=resultadoPasaAltos2[0];
    resultadoPasaAltos2[1]=resultadoPasaAltos2[0];
    resultadoPasaAltos2[2]=resultadoPasaAltos2[0];
    resultadoPasaAltos2[3]=resultadoPasaAltos2[0];
    
    for ( i = 3; i < 499; i++ ) {
        resultadoPasaBajos2[i] =resultadoPasaAltos2[i]*b[0]+resultadoPasaAltos2[i-1]*b[1]+resultadoPasaAltos2[i-2]*b[2]+resultadoPasaAltos2[i-3]*b[3]-(resultadoPasaBajos2[i-1]*a[1]+resultadoPasaBajos2[i-2]*a[2]+resultadoPasaBajos2[i-3]*a[3]);
    }

    for ( i = -1; i < 500; i++ ) {
      Serial.println(resultadoPasaBajos2[i]);
    }

    float frecuenciaCardiaca=calculoFrecuenciaCardiaca(resultadoPasaBajos2);
    Serial.print("El cálculo de la frecuencia cardíaca es de: ");
    Serial.println(frecuenciaCardiaca);


  while(1){}

}

float calculoFrecuenciaCardiaca(float entrada[500]){
    int cruces[500];
    int ubicacionCruces[500];
    int i;
    for (i=0;i<500;i++){
        cruces[i]=0;
    }
    for (i=0;i<500;i++){
        ubicacionCruces[i]=0;
    }
    int j=0;
    for (i=0;i<500;i++){
        if (resultadoPasaBajos2[i]<0 && resultadoPasaBajos2[i+1]>0){
            cruces[i]=100;
            ubicacionCruces[j]=i;
            j=j+1;
        }
    }
    for (i=0;i<500;i++){
        //printf( "%d\n", ubicacionCruces[i]);
    }
    float frecuencias[100];
    for (i=0;i<100;i++){
        frecuencias[i]=0;
    }
    i=0;
    while ((ubicacionCruces[i]>0) && (ubicacionCruces[i+1]>0)){
        frecuencias[i]=(float)100/(ubicacionCruces[i+1]-ubicacionCruces[i]);
        i=i+1;    
    }
    for (i=0;i<100;i++){
        //printf( "%f\n", frecuencias[i]);
    }
    float frecuenciaPromedio;
    i=0;
    frecuenciaPromedio=0;
    while (frecuencias[i]>0){
        frecuenciaPromedio=frecuenciaPromedio+frecuencias[i];
        i=i+1;
    }
    frecuenciaPromedio=frecuenciaPromedio/i;
    frecuenciaPromedio=60*frecuenciaPromedio;
    
    return frecuenciaPromedio;

}
