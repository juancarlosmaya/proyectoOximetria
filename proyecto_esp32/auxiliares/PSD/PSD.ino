/*
PSD DE SEÑAL ROJO E INFRAROJO
*/

#include "arduinoFFT.h"

arduinoFFT FFT = arduinoFFT(); /* Create FFT object */
/*
These values can be changed in order to evaluate the functions
*/
const uint16_t samples = 512; // //This value MUST ALWAYS be a power of 2
double senal5seg[samples];
const double samplingFrequency = 100;
const uint8_t amplitude = 100;
double senalPSD[samples/2];
double vImag2[samples];

/*
These are the input and output vectors
Input vectors receive computed results from FFT
*/
const uint16_t ventana= 128;
double vImag[ventana];
double muestra[ventana];
double psd[ventana/2];
double psdPromedio[ventana/2];
int i;

void setup()
{
  Serial.begin(115200);

}

void loop()
{


  //double senalIR[512]={0, 0, 0, 0, 0, 0, 3.29, 3.29, 3.29, 3.29, 3.43, 4.22, 6.21,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 0,};
  double senalIR[512]={0,0,0,0,0,0,0,0,1,2,3,5,7,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0,0};
  double senalRojo[512]={0,0,0,0,0,0,0,2,6,13,23,34,45,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0,0};
  

  
  
  /* Print the results of the simulated sampling according to time */
  Serial.println("Data:");
  for (i=0;i<samples;i++){
    senal5seg[i]=senalIR[i];
  }

  // submuestreo 1/2
  int j=0;
  for (i=0;i<samples;i=i+2){
    senalPSD[j]=senal5seg[i];
    j++;
  }
  
  // Hamming
  // FFT.Windowing(vReal, samples, FFT_WIN_TYP_HAMMING, FFT_FORWARD);	/* Weigh data */

  
  int overlap= int(ventana*0.7);
  int saltoNuevaVentana= ventana-overlap;
  int numeroVentanaActual=0;
  int puntero;
  for (i=0;i<ventana/2;i++) {psdPromedio[i]=0;}
  for (puntero=0;puntero<((samples/2)-ventana);puntero=(puntero+saltoNuevaVentana)){
    numeroVentanaActual=numeroVentanaActual+1;

    // Extraer muestra
    for (i=0;i<=ventana;i++){
      muestra[i]=senalPSD[puntero+i];
    }  

    // Hamming
    FFT.Windowing(muestra, ventana, FFT_WIN_TYP_HAMMING, FFT_FORWARD);  /* Weigh data */

    // Fourier
    for (i=0;i<ventana;i++){vImag[i]=0;}
    FFT.Compute(muestra, vImag, ventana, FFT_FORWARD); /* Compute FFT */
    FFT.ComplexToMagnitude(muestra, vImag, ventana); /* Compute magnitudes */
    //Serial.println("psd muestra");
    for (i=0;i<ventana/2;i++){
      psd[i]=2*muestra[i]*muestra[i]/(ventana*50.48);
      psdPromedio[i]=psdPromedio[i]+psd[i];
      //Serial.println(psd[i]);
    }
    
    

  }
  Serial.println("PSD promedio");
  for (i=0;i<ventana/2;i++){
    psdPromedio[i]=psdPromedio[i]/numeroVentanaActual;
    Serial.println(psdPromedio[i]);
  }

  //  Encontrar el PSD[j] máximo
  double maxPSD_v=0;
  double maxPSD_i=0; 
  for ( int i = 0; i < ventana/2; i++ )
  {
    if ( psdPromedio[i] > maxPSD_v )
    {
       maxPSD_v = psdPromedio[i];
       maxPSD_i = i;
    }
  }

  double valorAC=maxPSD_v;
  double frecuenciaMaxima= maxPSD_i*(((samplingFrequency/2)/2)/(ventana/2));
  Serial.print("El valor AC es: ");
  Serial.println(valorAC);
  
  Serial.print("la frecuencia cardíaca es: ");
  Serial.println(frecuenciaMaxima*60);

  
  



  while(1); /* Run Once */

}
//////////////////////////////////////
//El valor AC es: 23701.82////////////
//la frecuencia cardíaca es: 93.75////
//////////////////////7777////////////


  /*
  FFT.Compute(senal5seg, vImag2, samples, FFT_FORWARD); 
  FFT.ComplexToMagnitude(senal5seg, vImag2, samples); 
  Serial.println("Computed magnitudes:");
  for (i=0;i<samples/2;i++){
    Serial.println(senal5seg[i]);
  }
  

  double x = FFT.MajorPeak(senal5seg, samples, samplingFrequency);
  Serial.print("La frecuencia cardíaca es de: ");
  Serial.println(x*60, 6);
  */
